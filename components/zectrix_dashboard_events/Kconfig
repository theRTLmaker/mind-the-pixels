## components/zectrix_dashboard_events/Kconfig
```kconfig
menu "Dashboard events"

config ZECTRIX_EVENTS_URL
    string "events.json URL"
    default ""
    help
        Raw URL of the curated events.json (e.g. a secret gist's
        https://gist.githubusercontent.com/<user>/<id>/raw/events.json).
        Leave empty to show "Events not connected". A secret gist URL is
        private by obscurity only, so it lives in the gitignored sdkconfig;
        never commit it.

endmenu
```

## components/zectrix_dashboard_trains/Kconfig
```kconfig
menu "Dashboard trains"

config ZECTRIX_TRAINS_RDM_API_KEY
    string "Rail Data Marketplace API key"
    default ""
    help
        Consumer key for the Rail Data Marketplace "Live Departure Board -
        Staff Version" product. Leave empty to use the public Huxley server
        only. Lives in the gitignored sdkconfig; never commit it.

config ZECTRIX_TRAINS_RDM_URL
    string "Rail Data Marketplace departures base URL"
    default "https://api1.raildata.org.uk/1010-live-departure-board---staff-version1_0/LDBSVWS/api/20220120/GetDepBoardWithDetails"
    help
        GetDepBoardWithDetails endpoint without the trailing /{crs}/{time}.
        The firmware appends /SFA/<yyyymmddThhmmss> and a query filtered to
        trains calling at St Pancras (STP).

endmenu
```

## components/zectrix_dashboard_wifi/Kconfig
```kconfig
menu "Dashboard Wi-Fi"

config ZECTRIX_DASHBOARD_WIFI_SSID
    string "Dashboard Wi-Fi SSID"
    default ""
    help
        Network the dashboard joins. Lives in the gitignored sdkconfig.

config ZECTRIX_DASHBOARD_WIFI_PASSWORD
    string "Dashboard Wi-Fi password"
    default ""
    help
        Lives in the gitignored sdkconfig; never commit it.

endmenu
```
